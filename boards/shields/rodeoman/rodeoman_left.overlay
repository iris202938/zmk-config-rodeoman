#include "rodeoman.dtsi"
#include <input/processors.dtsi>
#include <dt-bindings/zmk/input_transform.h>


&trackball_input_listener_0 {
    status = "okay";
    device = <&trackball>;
    input-processors = <&zip_xy_scaler 8 1>;
};

&trackball_input_listener_1 {
    status = "okay";
};

&xiao_i2c {
    status = "okay";
    clock-frequency = <I2C_BITRATE_FAST>;
    trackball: trackball@a {
        compatible = "palette,az1uball";
        reg = <0x0A>;
        status = "okay";
    };
};

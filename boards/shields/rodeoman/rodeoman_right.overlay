#include "rodeoman.dtsi"
#include <input/processors.dtsi>
#include <dt-bindings/zmk/input_transform.h>

&default_transform {
    col-offset = <5>;
};

&trackball_split {
    device = <&trackball>;
    input-processors = <&zip_xy_to_scroll_mapper>
                     , <&zip_scroll_transform (INPUT_TRANSFORM_Y_INVERT) >
                     ;
};

&xiao_i2c {
    status = "okay";
    clock-frequency = <I2C_BITRATE_FAST>;
    trackball: trackball@a {
        compatible = "palette,az1uball";
        reg = <0x0A>;
        status = "okay";
    };
};
